## config/boards/shields/butterfly_air/kconfig.defconfig
```kconfig
if SHIELD_BUTTERFLY_AIR

config ZMK_KEYBOARD_NAME
    default "Butterfly Air"

endif
```

## config/west.yml
```yaml
manifest:
  remotes:
    - name: zmkfirmware
      url-base: https://github.com/zmkfirmware

    - name: lilyongtest
      url-base: https://github.com/lilyongtest

  projects:
    - name: zmk
      remote: zmkfirmware
      revision: main
      import: app/west.yml

    - name: zmk_driver_azoteq
      remote: lilyongtest
      revision: master

  self:
    path: config
```
